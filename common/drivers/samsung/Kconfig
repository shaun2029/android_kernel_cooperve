## common/drivers/samsung/Kconfig
```kconfig
#
#
#

menuconfig SAMSUNG_MODULES
	tristate "Samsung Kernel Modules"
	default m
	help
	  Say Y to enable Samsung kernel modules. j4fs and param
	  modules are included.

menuconfig J4FS
	tristate "Samsung J4FS support"
	depends on SAMSUNG_MODULES
	default m
	help
	  Say Y to enable Samsung J4FS support.

menuconfig PARAM
	tristate "Samsung PARAM support"
	depends on SAMSUNG_MODULES
	default m
	help
	  Say Y to enable Samsung PARAM support.

menuconfig VIBETONZ
	tristate "Vibetonz"
	depends on SAMSUNG_MODULES
	default m
	help
	  Say Y to enable Vibetonz support.

menuconfig STORAGE
        tristate "Storage"
        depends on SAMSUNG_MODULES && SAMSUNG_PHONE_SVNET
        default m
        help
          Say Y to enable DGS info support.

menuconfig LEVEL
        tristate "Level"
        depends on SAMSUNG_MODULES && SAMSUNG_PHONE_SVNET
        default m
        help
          Say Y to enable Debug Level support.
```
